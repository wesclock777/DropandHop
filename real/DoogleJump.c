#include <stdio.h>
#include <stdint.h>
#include "tm4c123gh6pm.h"
/*#include "LCD.h"
#include "random.h"
#include "ST7735.c"
#include "TExaS.h"
#include "ADC.h"
#include "Timers.h"
#include "Print.s"
#include "DAC.h"*/

void EnableInterrupts(void);
void DisableInterrupts(void);

//Resources. c file

struct Player{
		uint8_t xpos,ypos;
		uint8_t alive;
		uint8_t freshly_exploded;
		int8_t lives;
		uint32_t score;
		uint32_t direction; //left is 1, right is 0;
		const unsigned short *graphic[2]; //one is player facing right, two is player facing left
};
typedef struct Player Player;

struct Enemy{
	uint8_t xpos,ypos;
	uint8_t alive;
	uint8_t freshly_exploded;
  uint8_t shoot_freq;
  uint8_t point_value;
	uint8_t direction;
	uint32_t enemycount;
	uint32_t enemyreload;
  const unsigned short *graphic[2];
	//uint8_t **graphic_active;
};
typedef struct Enemy Enemy;

struct Block{
	uint8_t xpos,ypos;
	const unsigned short *graphic;
	uint8_t alive;
	//uint8_t **graphic_active;
};
typedef struct Block Block;

struct Fireball{
	uint8_t xpos, ypos;
	uint8_t direction; // 0 for right, 1 for left
	uint8_t alive;
	const unsigned short *graphic;
	//uint8_t **graphic_active;
};
typedef struct Fireball Fireball;

// Definitions for bitmap images

	const unsigned short Charactergraphic[] = {
 0xFFFF, 0x31E9, 0x31E9, 0xFFFF, 0xFFFF, 0xFFFF, 0xFFFF, 0xFFFF, 0x31E9, 0x31E9, 0xFFFF, 0x31E9, 0x31E9, 0xFFFF, 0xFFFF, 0xFFFF,
 0xFFFF, 0xFFFF, 0x31E9, 0x31E9, 0xFFFF, 0xFFFF, 0xFFFF, 0xFFFF, 0xFFFF, 0x31E9, 0x31E9, 0xFFFF, 0x31E9, 0x31E9, 0xFFFF, 0xFFFF,
 0xFFFF, 0xFFFF, 0xFFFF, 0x184C, 0x184C, 0x184C, 0x184C, 0x184C, 0x184C, 0x184C, 0x21D1, 0x21D1, 0xFFFF, 0x31E9, 0x31E9, 0xFFFF,
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 0xFFFF, 0xFFDF, 0xFFDF, 0xFFFF, 0xFFFF, 0xFFFF, 0xFFFF,

};
//width: 17 height: 17
const unsigned short Blockgraphic[] = {
 0x0000, 0x0000, 0x0000, 0x0000, 0x0000, 0x0000, 0x0000, 0x0000, 0x0000, 0x0000, 0x0000, 0x0000, 0x0000, 0x0000, 0x0000, 0x0000,
 0x0000, 0x0000, 0x0000, 0x1A31, 0x1A31, 0x1A31, 0x1A31, 0x1A31, 0x1A31, 0x1A31, 0x1A31, 0x1A31, 0x1A31, 0x1A31, 0x1A31, 0x1A31,
 0x0000, 0x0000, 0x0000, 0x1A31, 0x0000, 0x1A31, 0x1A31, 0x1A31, 0x1A31, 0x1A31, 0x1A31, 0x1A31, 0x1A31, 0x1A31, 0x1A31, 0x1A31,
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 0x0000,

};

//width: 8, height: 7

const unsigned short FireballgraphicL[] = {
 0xFFFF, 0xFFFF, 0x027A, 0x027A, 0x001F, 0x063F, 0x04BF, 0x001F, 0xFFFF, 0x027B, 0x0233, 0x027B, 0x0172, 0x05DD, 0x049F, 0xFFFF,
 0x027A, 0x0173, 0x027A, 0x0173, 0x0233, 0x0217, 0x07BF, 0x001F, 0x0257, 0x027A, 0x027A, 0x0233, 0x027A, 0x0217, 0x027A, 0x001F,
 0x027A, 0x0173, 0x027A, 0x0173, 0x0233, 0x0217, 0x07BF, 0x001F, 0xFFFF, 0x027B, 0x0233, 0x027B, 0x0172, 0x05DD, 0x049F, 0xFFFF,
 0xFFFF, 0xFFFF, 0x027A, 0x027A, 0x001F, 0x063F, 0x04BF, 0x001F,

};

//width:16, height:10
const uint8_t SmallEnemy10PointA[] = {
 0x42, 0x4D, 0xC6, 0x00, 0x00, 0x00, 0x00, 0x00, 0x00, 0x00, 0x76, 0x00, 0x00, 0x00, 0x28, 0x00, 0x00, 0x00, 0x10, 0x00, 0x00, 0x00, 0x0A, 0x00, 0x00, 0x00, 0x01, 0x00, 0x04, 0x00, 0x00, 0x00,
 0x00, 0x00, 0x50, 0x00, 0x00, 0x00, 0x00, 0x00, 0x00, 0x00, 0x00, 0x00, 0x00, 0x00, 0x00, 0x00, 0x00, 0x00, 0x00, 0x00, 0x00, 0x00, 0x00, 0x00, 0x00, 0x00, 0x00, 0x00, 0x80, 0x00, 0x00, 0x80,
 0x00, 0x00, 0x00, 0x80, 0x80, 0x00, 0x80, 0x00, 0x00, 0x00, 0x80, 0x00, 0x80, 0x00, 0x80, 0x80, 0x00, 0x00, 0x80, 0x80, 0x80, 0x00, 0xC0, 0xC0, 0xC0, 0x00, 0x00, 0x00, 0xFF, 0x00, 0x00, 0xFF,
 0x00, 0x00, 0x00, 0xFF, 0xFF, 0x00, 0xFF, 0x00, 0x00, 0x00, 0xFF, 0x00, 0xFF, 0x00, 0xFF, 0xFF, 0x00, 0x00, 0xFF, 0xFF, 0xFF, 0x00, 0x00, 0x00, 0x00, 0x00, 0x00, 0x00, 0x00, 0x00, 0x00, 0x00,
 0x0F, 0xF0, 0x0F, 0xF0, 0x00, 0x00, 0x00, 0xF0, 0xF0, 0x00, 0x00, 0x0F, 0x0F, 0x00, 0x00, 0xFF, 0xFF, 0xFF, 0xFF, 0xFF, 0xFF, 0x00, 0x00, 0xFF, 0xFF, 0xFF, 0xFF, 0xFF, 0xFF, 0x00, 0x00, 0x0F,
 0xF0, 0xFF, 0xFF, 0x0F, 0xF0, 0x00, 0x00, 0x00, 0xFF, 0xFF, 0xFF, 0xFF, 0x00, 0x00, 0x00, 0x00, 0x0F, 0x00, 0x00, 0xF0, 0x00, 0x00, 0x00, 0x00, 0xF0, 0x00, 0x00, 0x0F, 0x00, 0x00, 0x00, 0x00,
 0x00, 0x00, 0x00, 0x00, 0x00, 0x00, 0xFF};

 // width:16, height=10
const uint8_t SmallExplosion0[] = {
 0x42, 0x4D, 0xC6, 0x00, 0x00, 0x00, 0x00, 0x00, 0x00, 0x00, 0x76, 0x00, 0x00, 0x00, 0x28, 0x00, 0x00, 0x00, 0x10, 0x00, 0x00, 0x00, 0x0A, 0x00, 0x00, 0x00, 0x01, 0x00, 0x04, 0x00, 0x00, 0x00,
 0x00, 0x00, 0x50, 0x00, 0x00, 0x00, 0x00, 0x00, 0x00, 0x00, 0x00, 0x00, 0x00, 0x00, 0x00, 0x00, 0x00, 0x00, 0x00, 0x00, 0x00, 0x00, 0x00, 0x00, 0x00, 0x00, 0x00, 0x00, 0x80, 0x00, 0x00, 0x80,
 0x00, 0x00, 0x00, 0x80, 0x80, 0x00, 0x80, 0x00, 0x00, 0x00, 0x80, 0x00, 0x80, 0x00, 0x80, 0x80, 0x00, 0x00, 0x80, 0x80, 0x80, 0x00, 0xC0, 0xC0, 0xC0, 0x00, 0x00, 0x00, 0xFF, 0x00, 0x00, 0xFF,
 0x00, 0x00, 0x00, 0xFF, 0xFF, 0x00, 0xFF, 0x00, 0x00, 0x00, 0xFF, 0x00, 0xFF, 0x00, 0xFF, 0xFF, 0x00, 0x00, 0xFF, 0xFF, 0xFF, 0x00, 0x00, 0x00, 0x00, 0x00, 0x00, 0x00, 0x00, 0x00, 0x00, 0xF0,
 0x0F, 0x00, 0x0F, 0x00, 0xF0, 0x00, 0x00, 0x0F, 0x00, 0xF0, 0xF0, 0x0F, 0x00, 0x00, 0x00, 0x00, 0xF0, 0x00, 0x00, 0xF0, 0x00, 0x00, 0x0F, 0xF0, 0x00, 0x00, 0x00, 0x00, 0xFF, 0x00, 0x00, 0x00,
 0xF0, 0x00, 0x00, 0xF0, 0x00, 0x00, 0x00, 0x0F, 0x00, 0x00, 0x00, 0x0F, 0x00, 0x00, 0x00, 0xF0, 0x00, 0xF0, 0xF0, 0x00, 0xF0, 0x00, 0x00, 0x00, 0x0F, 0x00, 0x0F, 0x00, 0x00, 0x00, 0x00, 0x00,
 0x00, 0x00, 0x00, 0x00, 0x00, 0x00, 0xFF};

// Setup for the file structure: 
//     Controls.c (includes ADC, GPIO buttons)
//     Communication.c (includes UART and FIFO, for possible two player)
//     Sound.c (SysTick audio, DAC)
//     Resources.c (Graphics definitions)
//     Lab10.c (Game engine and main)
 
#define ONE_PLAYER      0
#define TWO_PLAYER      0
#define PLAYER_WIDTH    18
#define PLAYER_HEIGHT		8
#define ENEMY_HEIGHT    10
#define ENEMY_WIDTH 		16
#define FIREBALL_HEIGHT	9
#define FIREBALL_WIDTH		4
#define BLOCK_WIDTH		17
#define BLOCK_HEIGHT  17


static Enemy enemies[5];
static Fireball Fireballs[4];
static Player player;
static Block blocks[50];
uint8_t level = 1;
uint32_t fireballcount;
uint32_t gravitycount;
uint32_t jumpcount;
uint32_t fireballreload;
uint32_t playercount;
uint32_t playerreload;
uint32_t gravityreload;
uint32_t jumpreload;
uint32_t lastadcvalue;


void checkCollision(void){
	uint8_t i=0;
	
	//check if player has been hit
	for (i=0;i<4;i++){
			if (enemies[i].alive){
				if (((127-player.xpos) <= enemies[i].xpos) & (enemies[i].xpos <= (127-player.xpos+PLAYER_WIDTH)) & (enemies[i].ypos >= (player.ypos - PLAYER_HEIGHT)) & (enemies[i].ypos <=159)){
					// hit
					player.graphic[0] = &SmallExplosion0[0];
				  player.alive = 0;
					playercount=playerreload;
				  player.lives --;
				  enemies[i].alive = 0;
			}
			}
	}
	
	//Delete any missed shots
	if(((Fireballs[0].xpos<=0)||(Fireballs[0].xpos>127))& (Fireballs[0].alive!=0)){
		Fireballs[0].alive =0;
	}
	
	//If enemies reach bottom of screen, they die
	for(i=0;i<5;i++) {
		if(enemies[i].ypos>160)
		enemies[i].alive=0;
	}
	
	//Check if a fireball hits a enemy
	
	for( i=0; i<5; i++){
		if(((enemies[i].ypos >= (Fireballs[0].ypos - 9)) & (enemies[i].xpos <= Fireballs[0].xpos) & (Fireballs[0].xpos <= (enemies[i].xpos + ENEMY_WIDTH)) & (Fireballs[0].alive) & enemies[i].alive)){
			enemies[i].graphic[0]= &SmallExplosion0[0];
			Fireballs[0].alive=0;
			enemies[i].freshly_exploded =1;
			player.score += enemies[i].point_value;
			//some timer here
	
		}
	}	
	//check if fireball hits a block
	
	if(Fireballs[0].alive){
		for(int j=0; j<50;j++)
		if((Fireballs[0].xpos==blocks[j].xpos+BLOCK_WIDTH||(Fireballs[0].xpos+FIREBALL_WIDTH==blocks[j].xpos))){
			if((Fireballs[0].ypos<=blocks[j].ypos+BLOCK_HEIGHT)&&(Fireballs[0].ypos+FIREBALL_HEIGHT>=blocks[j].ypos)){
				Fireballs[0].alive=0;
			
			}
		}
		
	}
}
void singlePlayerRespawn(void){
		player.alive = 1;
		player.freshly_exploded = 0;
		//player.graphic = &Charactergraphic;
		//reset lvl code goes here
}
	
void fire(uint8_t xpos, uint8_t ypos, uint8_t direction){
	uint8_t i=0;
	if(direction==0)
		if(Fireballs[0].alive==0){ //fire right
			Fireballs[0].xpos = player.xpos+PLAYER_WIDTH;
			Fireballs[0].ypos = player.ypos;
			Fireballs[0].alive = 1;
			Fireballs[0].direction = 0;
			Fireballs[0].graphic=&FireballgraphicR;
			return;}
	if(direction==1)
		if(Fireballs[0].alive==0){ //fire left
			Fireballs[0].xpos = player.xpos;
			Fireballs[0].ypos = player.ypos;
			Fireballs[0].alive = 1;
			Fireballs[0].direction = 1;
			Fireballs[0].graphic=&FireballgraphicL;
			return;}
}

void advancefireball(void){
	uint8_t i=0;
	for (i=0;i<4;i++){
		if (Fireballs[i].alive){
			if(Fireballs[i].direction==0)
			{
				Fireballs[i].xpos++;
			}
			if(Fireballs[i].direction==1)
			{
				Fireballs[i].xpos--;
			}
		}
	}
}

void advanceEnemy(void){ //moves enemies back and forth on the xpos
	uint8_t i=0;
	for(i=0;i<5;i++){
		if (enemies[i].xpos == 128){
			enemies[i].direction = 1;
		} else if (enemies[i].xpos == 0){
			enemies[i].direction = 0;
		}
		if (enemies[i].direction == 0){		
			for(i=0; i<5; i++){
				enemies[i].xpos += 1;
				
			}
		}
		else if (enemies[i].direction == 1){
			for(i=0; i<5; i++){
				enemies[i].xpos -= 1;
			}
		}
	}
}

void gravity(int num){
	
	if(player.alive==0)
	{
		return; //dont move things down if the player is dead
	}	
	for(int i=0; i<5;i++) //gravity for enemies, blocks, and player
	{
		enemies[i].ypos+=1;
	}
	for(int j=0; j<50; j++)
	{
		blocks[j].ypos+=1;
	}
	if(player.ypos==160){ //player hits bottom of screen
		
		player.graphic[0] = &SmallExplosion0[0];
		player.freshly_exploded = 1;
		player.alive = 0;
		player.lives --;
		player.xpos=128/2;
	  player.ypos=160/2; //reset character to middle of screen
		return;
	}
	player.ypos+=1;
	
	//clear dead enemies
	for (int j=0;j<5;j++){
				if (enemies[j].freshly_exploded == 1){
					enemies[j].alive = 0;
					enemies[j].freshly_exploded = 0;
					const uint8_t *blank_enemy = &SmallExplosion0[0];
					enemies[j].graphic = &blank_enemy;
				}
			}
	
	
}
void jump(){
	//use at^2 to calculate position based on time
	




}	

void GPIOPortA_Handler(void){ // jump button press
	GPIO_PORTA_ICR_R = 0x20;// acknowledge flags
	GPIO_PORTF_DATA_R ^= 0x04;
	for(int i=0;i<50;i++)
	{
		if(player.ypos+PLAYER_HEIGHT==blocks[i].ypos){ //checks to see if on ground
		jump();	
		
		}	
	
	}	
}



void GPIOPortE_Handler(void){ // fire button press
	GPIO_PORTE_ICR_R = 0x20;// acknowledge flags
	GPIO_PORTF_DATA_R ^= 0x04;
	if(player.direction==0){fire(player.xpos, player.ypos, 0);}
	if(player.direction==1){fire(player.xpos, player.ypos, 1);}
}

void PlayerInit(uint8_t u){ //initializes the level
	return;

}

void RefreshScreen(void){
	ST7735_PlotClear(0,160);
	
		//note: display background needs to be added here
	
	if (player.lives <= 0){ //check to see if player is dead
		char i[] ="Game Over!";
		ST7735_DrawString(x, y, i, color);
		char j[] ="Final Score: ";
		ST7735_DrawString(x, y, j, color);
		ST7735_SetCursor(x, y);
		ST7735_OutUDec(player.score);
		char k[] = "Retry?";
		ST7735_DrawString(x, y, k, color);
		if ((GPIO_PORTE_DATA_R & 0x20) == 0x20)
			{
					level = 1;
					PlayerInit(level);
			}

	}
	ST7735_PlotClear(0,160); //draw score and lives
	char m[]="Lives: ";
	char n[]="Score: ";
	ST7735_DrawString(x, y, m, 0);
	ST7735_DrawString(x, y, n, 0);
	ST7735_SetCursor(x, y);
  ST7735_OutUDec(player.score);
	ST7735_SetCursor(x, y);
  ST7735_OutUDec(player.lives);
	
	if (player.alive){	//draw player based on slide port
			uint32_t x = ADC_In();
			x = (x/4095)*128;
			player.xpos = x;
			if(player.direction==0){
			ST7735_PrintBMP(player.xpos, player.ypos, player.graphic[0], PLAYER_WIDTH, PLAYER_HEIGHT);
			}
			if(player.direction==1){
			ST7735_PrintBMP(player.xpos, player.ypos, player.graphic[1], PLAYER_WIDTH, PLAYER_HEIGHT);
			}	
	}
	else{
		
		ST7735_PrintBMP(player.xpos, player.ypos, &SmallExplosion0[0], PLAYER_WIDTH, PLAYER_HEIGHT);
		{
			if(playercount==0){
			player.alive=1;
			}
			else{playercount--;}
		
	}	
	for(int i=0;i<50;i++) //draw blocks
	{
		if(blocks[i].alive==1){
		ST7735_PrintBMP(blocks[i].xpos, blocks[i].ypos, blocks[i].graphic, BLOCK_WIDTH, BLOCK_HEIGHT);
		}
	}
	
	for(int j=0;j<5;j++) //draw enemies
	{
		if(enemies[j].enemycount==0){ advanceenemy();
		enemies[j].enemycount=enemies[j].enemyreload;
		}
		else{enemies[j].enemycount--;}
		if(enemies[j].alive==1){
		ST7735_PrintBMP(enemies[j].xpos, enemies[j].ypos, enemies[j].graphic, ENEMY_WIDTH, ENEMY_HEIGHT);
		}
	}
	if(Fireballs[0].alive)
	{
		ST7735_PrintBMP(Fireballs[0].xpos, Fireballs[0].ypos, Fireballs[0].graphic, FIREBALL_WIDTH, FIREBALL_HEIGHT);
	}	
	
	if(gravitycount==0){
		gravity(1);
		gravitycount=gravityreload;
	}
	else{gravitycount--;}
	
	if(fireballcount==0){ advancefireball();
		fireballcount=fireballreload;
	}
	else{fireballcount--;}
	checkCollision();
	}
}


int main(void){
	DisableInterrupts();
	TExaS_Init();
	LCD_Init();
	ADC_Init();
	DAC_Init();
	GPIO_Init();
	//stuff goes here to initialize main menus and lvls
	//initialize all count and reload values (player init)
	//loop into refresh screen
	
}





	